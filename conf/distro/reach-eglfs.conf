## conf/distro/reach-eglfs.conf
```bitbake
require conf/distro/poky.conf

#@NAME: reach-eglfs
#@DESCRIPTION: Reach eglfs based distro

DISTRO = "reach-eglfs"
DISTRO_NAME = "Reach Technology eglfs"
DISTROOVERRIDES = "reach"

DISTRO_FEATURES_append = " opengl"
DISTRO_FEATURES_append = " optee"
DISTRO_FEATURES_append = " virtualization"
DISTRO_FEATURES_remove = "wayland 3g nfc x11 directfb vulkan zeroconf"

SDKPATH = "/opt/reach/sdk/${SDK_VERSION}"
SDK_VENDOR = "-reachsdk"

MAINTAINER = "Reach Technology <techsupport@reachtech.com>"

TARGET_VENDOR = "-reach"

# Log information on images and packages
INHERIT += "buildhistory"
BUILDHISTORY_COMMIT = "1"

PREFERRED_PROVIDER_libevent = "libevent-fb"
PREFERRED_PROVIDER_jpeg = "libjpeg-turbo"
PREFERRED_PROVIDER_jpeg-native = "libjpeg-turbo-native"
PREFERRED_PROVIDER_console-tools = "kbd"

ACCEPT_EULA_stm32mp1 = "1"

LICENSE_FLAGS_WHITELIST += " non-commercial commercial"
```

## conf/distro/reach-weston.conf
```bitbake
require conf/distro/poky.conf

#@NAME: reach-weston
#@DESCRIPTION: Reach weston based distro

DISTRO = "reach-weston"
DISTRO_NAME = "Reach Technology weston"
DISTROOVERRIDES = "reach"

DISTRO_FEATURES_append = " wayland "
DISTRO_FEATURES_append = " opengl"
DISTRO_FEATURES_append = " optee"
DISTRO_FEATURES_append = " virtualization"
DISTRO_FEATURES_remove = "3g nfc x11 directfb vulkan zeroconf"

SDKPATH = "/opt/reach/sdk/${SDK_VERSION}"
SDK_VENDOR = "-reachsdk"

MAINTAINER = "Reach Technology <techsupport@reachtech.com>"

TARGET_VENDOR = "-reach"

# Log information on images and packages
INHERIT += "buildhistory"
BUILDHISTORY_COMMIT = "1"

PREFERRED_PROVIDER_libevent = "libevent-fb"
PREFERRED_PROVIDER_jpeg = "libjpeg-turbo"
PREFERRED_PROVIDER_jpeg-native = "libjpeg-turbo-native"
PREFERRED_PROVIDER_console-tools = "kbd"

ACCEPT_EULA_stm32mp1 = "1"

LICENSE_FLAGS_WHITELIST += " non-commercial commercial"
```

## conf/machine/stm32mp1.conf
```bitbake
#@TYPE: Machine
#@NAME: stm32mp1
#@DESCRIPTION: Configuration for all STM32MP1 boards (EV, DK, ...)
#@NEEDED_BSPLAYERS: layers/meta-openembedded/meta-oe layers/meta-openembedded/meta-python

include conf/machine/include/st-machine-common-stm32mp.inc
include conf/machine/include/st-machine-providers-stm32mp.inc

# Define specific familly common machine name
MACHINEOVERRIDES .= ":stm32mp1common"

# =========================================================================
# Chip architecture
# =========================================================================
DEFAULTTUNE = "cortexa7thf-neon-vfpv4"
include conf/machine/include/tune-cortexa7.inc

# =========================================================================
# boot scheme
# =========================================================================
BOOTSCHEME_LABELS += "trusted"
BOOTSCHEME_LABELS += "optee"

# =========================================================================
# boot device
# =========================================================================
# Define the boot device supported
BOOTDEVICE_LABELS += "sdcard"

# =========================================================================
# Machine settings
# =========================================================================
# Define list of devicetree per board
STM32MP_DT_FILES_DK += "stm32mp157a-dk1 stm32mp157d-dk1"
STM32MP_DT_FILES_DK += "stm32mp157c-dk2 stm32mp157f-dk2"
STM32MP_DT_FILES_ED += "stm32mp157c-ed1 stm32mp157f-ed1"
STM32MP_DT_FILES_EV += "stm32mp157a-ev1 stm32mp157c-ev1 stm32mp157d-ev1 stm32mp157f-ev1"

# =========================================================================
# Machine features
# =========================================================================
MACHINE_FEATURES += "splashscreen"
MACHINE_FEATURES += "watchdog"
MACHINE_FEATURES += "bluetooth"
MACHINE_FEATURES += "wifi"
MACHINE_FEATURES += "${@'gpu' if d.getVar('ACCEPT_EULA_'+d.getVar('MACHINE')) == '1' else ''}"
MACHINE_FEATURES += "m4copro"
```
